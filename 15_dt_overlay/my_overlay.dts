/dts-v1/;
/plugin/;


/{

	fragment@0{

		target-path ="/";
		__overlay__{

			my_Dev_lable: my_device {

				compatible = "brightlight,mydev";
				status = "okay";
				string_var = "Hello DT";
				int_var = <123>;

			};
		};
	};

};


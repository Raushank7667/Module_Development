/dts-v1/;
/plugin/;


/{

	fragment@0{

		target-path ="/";
		__overlay__{

			my_Dev_lable: my_device {

				compatible = "brightlight,mydev";
				status = "okay";
				interrupts-extended =<&gpio 20 2>;// 2 stands for on the rising edge intrrupt will trigger


			};
		};
	};

};

